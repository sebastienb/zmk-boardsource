## app/boards/shields/boardsource_equals60diy/Kconfig.defconfig
```kconfig
if SHIELD_BOARDSOURCE_EQUALS60_DIY

config ZMK_KEYBOARD_NAME
    default "Equals 60 LP"

endif
```

## app/boards/shields/boardsource_equals60diy/Kconfig.shield
```kconfig
config SHIELD_BOARDSOURCE_EQUALS60_DIY
    def_bool $(shields_list_contains,boardsource_equals60_diy)
```
